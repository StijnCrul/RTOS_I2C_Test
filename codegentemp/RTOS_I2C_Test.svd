# CY8C6247BZI_D54 register map
File version: 0.1
PSoC 62
Registers are 8-bit, read-write, no defined reset value unless marked. A register's access mark holds for its fields unless they carry their own. Offsets are from the block's base; lines under a group give offsets from that group; [hi:lo] are bit positions; {n}, {i} and the like mark numbered series; 'fields as' and 'values as' point back to an identical list; <NAME> marks a mode.

## Memory map
0x00000000 AMuxCtrl

## AMuxCtrl
Base 0x00000000
0x4034171C AMuxCtrl_CONTROL_REG
